## conf/bblayers.conf
```bitbake
# POKY_BBLAYERS_CONF_VERSION is increased each time build/conf/bblayers.conf
# changes incompatibly
POKY_BBLAYERS_CONF_VERSION = "2"

BBPATH = "${TOPDIR}"
BBFILES ?= ""

BBLAYERS ?= " \
  /home/ubuntu/poky/meta \
  /home/ubuntu/poky/meta-poky \
  /home/ubuntu/poky/meta-yocto-bsp \
  /home/ubuntu/poky/meta-openembedded/meta-oe \
  /home/ubuntu/poky/meta-openembedded/meta-networking \
  /home/ubuntu/poky/meta-openembedded/meta-multimedia \
  /home/ubuntu/poky/meta-openembedded/meta-python \
  /home/ubuntu/poky/meta-raspberrypi \
  "
```
